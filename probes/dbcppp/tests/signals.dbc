VERSION "EmberBSD installed consumer"

NS_ :

BS_:

BU_: ECU Tester

BO_ 100 Sample: 8 ECU
 SG_ Little : 0|16@1+ (1,0) [0|65535] "count" Tester
 SG_ Big : 23|16@0+ (1,0) [0|65535] "count" Tester
 SG_ Signed : 32|8@1- (0.5,-10) [-74|53.5] "degC" Tester
 SG_ Selector M : 40|8@1+ (1,0) [0|255] "" Tester
 SG_ VariantOne m1 : 48|8@1+ (2,1) [1|511] "" Tester
 SG_ VariantTwo m2 : 48|8@1+ (3,-1) [-1|764] "" Tester
